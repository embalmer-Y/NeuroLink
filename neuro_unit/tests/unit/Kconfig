## neuro_unit/tests/unit/Kconfig
```kconfig
source "Kconfig.zephyr"

menu "NeuroLink Unit Tests"

config NEUROLINK_PROTOCOL_CBOR
	bool "Enable NeuroLink CBOR-v2 protocol codec support"
	default y
	select ZCBOR
	select ZCBOR_CANONICAL
	help
	  Builds the zcbor-backed NeuroLink CBOR-v2 codec facade for unit tests.

config NEUROLINK_ZENOH_CONNECT
	string "Zenoh connect endpoint for tests"
	default "tcp/192.168.2.95:7447"
	help
	  Default zenoh connect locator used by lightweight transport config tests.

config NEUROLINK_APP_STATIC_ELF_BUFFER_SIZE
	int "Static LLEXT ELF staging buffer size for tests"
	default 0
	help
	  Reserves a small static buffer in native_sim tests so app-runtime LLEXT
	  staging fallback behavior can be covered without pulling in full LLEXT.

config NEUROLINK_APP_PREFER_EXTERNAL_ELF_BUFFER
	bool "Prefer external memory for LLEXT ELF staging buffer in tests"
	default n

config NEUROLINK_APP_PREFER_PSRAM_ELF_BUFFER
	bool "Legacy alias: prefer PSRAM for LLEXT ELF staging buffer in tests"
	select NEUROLINK_APP_PREFER_EXTERNAL_ELF_BUFFER
	default n

endmenu
```

## neuro_unit/tests/unit/testcase.yaml
```yaml
tests:
  neurolink.neuro_unit.modules:
    type: unit
    tags:
      - neurolink
      - neuro_unit
      - unit_ut
      - modules
    platform_allow:
      - native_sim
```
